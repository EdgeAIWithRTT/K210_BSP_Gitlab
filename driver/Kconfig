## driver/Kconfig
```kconfig
menu "Hardware Drivers"

config BSP_USING_UART_HS
    bool "Enable High Speed UART"
    default y

menu "General Purpose UARTs"

menuconfig BSP_USING_UART1
    bool "Enable UART1"
    default n
    if BSP_USING_UART1
        config BSP_UART1_TXD_PIN
            int "uart1 TXD pin number"
            default 20
        config BSP_UART1_RXD_PIN
            int "uart1 RXD pin number"
            default 21
    endif

menuconfig BSP_USING_UART2
    bool "Enable UART2"
    default n
    if BSP_USING_UART2
        config BSP_UART2_TXD_PIN
            int "uart2 TXD pin number"
            default 28
        config BSP_UART2_RXD_PIN
            int "uart2 RXD pin number"
            default 27
    endif

menuconfig BSP_USING_UART3
    bool "Enable UART3"
    default n
    if BSP_USING_UART3
        config BSP_UART3_TXD_PIN
            int "uart3 TXD pin number"
            default 22
        config BSP_UART3_RXD_PIN
            int "uart3 RXD pin number"
            default 23
    endif
endmenu

config BSP_USING_I2C0
    bool "Enable I2C0"
    select RT_USING_I2C
    default n
    if BSP_USING_I2C0
        config BSP_I2C0_SCL_PIN
            int "I2C0 SCL pin number"
            default 18
        config BSP_I2C0_SDA_PIN
            int "I2C0 SDA pin number"
            default 19
    endif

config BSP_USING_I2C1
    bool "Enable I2C1"
    select RT_USING_I2C
    default n
    if BSP_USING_I2C1
        config BSP_I2C1_SCL_PIN
            int "I2C1 SCL pin number"
            default 0
        config BSP_I2C1_SDA_PIN
            int "I2C1 SDA pin number"
            default 1
    endif

config BSP_USING_I2C2
    bool "Enable I2C2"
    select RT_USING_I2C
    default n
    if BSP_USING_I2C2
        config BSP_I2C2_SCL_PIN
            int "I2C2 SCL pin number"
            default 3
        config BSP_I2C2_SDA_PIN
            int "I2C2 SDA pin number"
            default 4
    endif

menuconfig BSP_USING_SPI1
    bool "Enable SPI1"
    select RT_USING_SPI
    default n
if BSP_USING_SPI1
    config BSP_USING_SPI1_AS_QSPI
        bool
        default n
    config BSP_SPI1_CLK_PIN
        int "spi1 clk pin number"
        default 29
    config BSP_SPI1_D0_PIN
        int "spi1 d0 pin number"
        default 30
    config BSP_SPI1_D1_PIN
        int "spi1 d1 pin number"
        default 31
    if BSP_USING_SPI1_AS_QSPI
        config BSP_SPI1_D2_PIN
            int "spi1 d2 pin number"
            default 32
        config BSP_SPI1_D3_PIN
            int "spi1 d3 pin number"
            default 33
    endif
    menuconfig BSP_SPI1_USING_SS0
        bool "SPI1 Enable SS0"
        default n
    if BSP_SPI1_USING_SS0
        config BSP_SPI1_SS0_PIN
            int "spi1 ss0 pin number"
            default 32
    endif
    menuconfig BSP_SPI1_USING_SS1
        bool "SPI1 Enable SS1"
        default n
    if BSP_SPI1_USING_SS1
        config BSP_SPI1_SS1_PIN
            int "spi1 ss1 pin number"
            default 25
    endif
    menuconfig BSP_SPI1_USING_SS2
        bool "SPI1 Enable SS2"
        default n
    if BSP_SPI1_USING_SS2
        config BSP_SPI1_SS2_PIN
            int "spi1 ss2 pin number"
            default 26
    endif
    menuconfig BSP_SPI1_USING_SS3
        bool "SPI1 Enable SS3"
        default n
    if BSP_SPI1_USING_SS3
        config BSP_SPI1_SS3_PIN
            int "spi1 ss3 pin number"
            default 27
    endif
endif

menuconfig BSP_USING_LCD
    bool "Enable LCD on SPI0"
    default n

if BSP_USING_LCD
    config BSP_LCD_CS_PIN
        int "CS pin number of 8080 interface"
        default 6
    config BSP_LCD_WR_PIN
        int "WR pin number of 8080 interface"
        default 7
    config BSP_LCD_DC_PIN
        int "DC pin number of 8080 interface"
        default 8
    config BSP_LCD_X_MAX
        int "LCD Height"
        default 240
    config BSP_LCD_Y_MAX
        int "LCD Width"
        default 320
endif

config BSP_USING_I2S0
    bool "Enable I2S0(Play Only)"
    select RT_USING_AUDIO
    default y
    if BSP_USING_I2S0
        config BSP_I2S0_OUT_D1_PIN
            int "I2S0 out_d1 pin number"
            default 33
        config BSP_I2S0_WS_PIN
            int "I2S0 ws pin number"
            default 34
        config BSP_I2S0_SCLK_PIN
            int "I2S0 sclk pin number"
            default 35
    endif

config BSP_USING_I2S1
    bool "Enable I2S1(Record Only)"
    select RT_USING_AUDIO
    default y
    if BSP_USING_I2S1
        config BSP_I2S1_IN_D0_PIN
            int "I2S1 in_d0 pin number"
            default 36
        config BSP_I2S1_WS_PIN
            int "I2S1 ws pin number"
            default 37
        config BSP_I2S1_SCLK_PIN
            int "I2S1 sclk pin number"
            default 38
    endif

config BSP_USING_I2S2
    bool "Enable I2S2"
    select RT_USING_AUDIO
    default n
    if BSP_USING_I2S2
        config BSP_I2S2_OUT_D1_PIN
            int "I2S2 out_d1 pin number"
            default 33
        config BSP_I2S2_WS_PIN
            int "I2S2 ws pin number"
            default 34
        config BSP_I2S2_SCLK_PIN
            int "I2S2 sclk pin number"
            default 35
    endif

menuconfig BSP_USING_PWM0
    bool "Enable PWM0"
    select RT_USING_PWM
    default y

    if BSP_USING_PWM0
        config BSP_PWM0_CHN0_ENABLE
            bool "Enable PWM0 Channel 0"
            default y

            if BSP_PWM0_CHN0_ENABLE
                config BSP_PWM0_CHN0_PIN
                int "pwm0 channel 0 pin number"
                default 24
            endif
    endif

menuconfig BSP_USING_PWM1
    bool "Enable PWM1"
    select RT_USING_PWM
    default n

    if BSP_USING_PWM1
        config BSP_PWM1_CHN0_ENABLE
            bool "Enable PWM1 Channel 0"
            default y

            if BSP_PWM1_CHN0_ENABLE
                config BSP_PWM1_CHN0_PIN
                int "pwm1 channel 0 pin number"
                default 24
            endif
    endif

menuconfig BSP_USING_PWM2
    bool "Enable PWM2"
    select RT_USING_PWM
    default n

    if BSP_USING_PWM2
        config BSP_PWM2_CHN0_ENABLE
            bool "Enable PWM2 Channel 0"
            default y

            if BSP_PWM2_CHN0_ENABLE
                config BSP_PWM2_CHN0_PIN
                int "pwm2 channel 0 pin number"
                default 24
            endif
    endif

config BSP_USING_TIMER0
    bool "Enable Timer0"
    select RT_USING_HWTIMER
    default n

config BSP_USING_TIMER1
    bool "Enable Timer1"
    select RT_USING_HWTIMER
    default y

config BSP_USING_TIMER2
    bool "Enable Timer2"
    select RT_USING_HWTIMER
    default n

config BSP_USING_CAMERA
    bool "Enable DVP Camera"
    default y

    if BSP_USING_CAMERA
        config BSP_CAMERA_SCCB_SDA0_PIN
            int "SCCB SDA-0 Pin for GC0328"
            default 13
        config BSP_CAMERA_SCCB_SDA_PIN
            int "SCCB SDA-1 Pin"
            default 9
        config BSP_CAMERA_SCCB_SCLK_PIN
            int "SCCB SCLK Pin"
            default 10
        config BSP_CAMERA_CMOS_RST_PIN
            int "RST Pin"
            default 11
        config BSP_CAMERA_CMOS_VSYNC_PIN
            int "VSYNC Pin"
            default 12
        config BSP_CAMERA_CMOS_PWDN_PIN
            int "PWDN Pin"
            default 13
        config BSP_CAMERA_CMOS_XCLK_PIN
            int "XCLK Pin"
            default 14
        config BSP_CAMERA_CMOS_PCLK_PIN
            int "PCLK Pin"
            default 15
        config BSP_CAMERA_CMOS_HREF_PIN
            int "HREF Pin"
            default 17

        config BSP_CAMERA_CMOS_PWDN_PIN_GC0328
            int "PWDN Pin for GC0328"
            default 11 
    endif

config BSP_USING_BRIDGE
    bool "Enable bridge module"
    depends on PKG_USING_OPENMV_CP
    if BSP_USING_BRIDGE
        config BRIDGE_INT_PIN
            int "bridge int PIN"
            default 30

        config BRIDGE_READY_PIN
            int "bridge ready PIN"
            default 31

        config BRIDGE_DATA_READY_PIN
            int "bridge data ready PIN"
            default 32

        config BRIDGE_CS_PIN
            int "bridge spi cs PIN"
            default 26

        config BRIDGE_CLK_PIN
            int "bridge spi clk PIN"
            default 27

        config BRIDGE_MOSI_PIN
            int "bridge spi mosi PIN"
            default 29

        config BRIDGE_MISO_PIN
            int "bridge spi mosi PIN"
            default 28
    endif

config BSP_USING_RW007
    bool "Enable RW007 wifi module"
    select PKG_USING_RW007
    select RT_USING_WIFI
    default n

    if BSP_USING_RW007
        config RW007_SPIDEV_NAME
            string "the SPIDEV rw007 driver on"
            default "spi11"

        config RW007_RST_PIN
            int "reset PIN"
            default 22

        config RW007_INT_BUSY_PIN
            int "INT and BUSY status pin"
            default 23
    endif

endmenu
```
